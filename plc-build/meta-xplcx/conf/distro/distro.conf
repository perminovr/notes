## plc-build/meta-xplcx/conf/layer.conf
```bitbake
# We have a conf and classes directory, add to BBPATH
BBPATH .= ":${LAYERDIR}"

# We have a packages directory, add to BBFILES
BBFILES += " ${LAYERDIR}/recipes-*/*/*.bb ${LAYERDIR}/recipes*/*/*.bbappend"

BBFILE_COLLECTIONS += "hmi"
BBFILE_PATTERN_hmi := "^${LAYERDIR}/"
BBFILE_PRIORITY_hmi = "19"

LAYERSERIES_COMPAT_meta-hmi = "thud"

INHERIT += "extrausers"
EXTRA_USERS_PARAMS = ""

ARAGO_SYSVINIT="1"
ARAGO_RT_ENABLE="1"

VIRTUAL-RUNTIME_init_manager = "sysvinit"
VIRTUAL-RUNTIME_initscripts = "initscripts"
DISTRO_FEATURES_append = " sysvinit "

DISTRO_FEATURES_remove += "\
	alsa bluetooth irda x11 eudev systemd \
"

MACHINE_FEATURES_remove += "\
	alsa keyboard efi \
"

# Available IMAGE_FEATURES:
#
# - x11                 - X server
# - x11-base            - X server with minimal environment
# - x11-sato            - OpenedHand Sato environment
# - tools-debug         - debugging tools
# - eclipse-debug       - Eclipse remote debugging support
# - tools-profile       - profiling tools
# - tools-testapps      - tools usable to make some device tests
# - tools-sdk           - SDK (C/C++ compiler, autotools, etc.)
# - nfs-server          - NFS server
# - nfs-client          - NFS client
# - ssh-server-dropbear - SSH server (dropbear)
# - ssh-server-openssh  - SSH server (openssh)
# - hwcodecs            - Install hardware acceleration codecs
# - package-management  - installs package management tools and preserves the package manager database
# - debug-tweaks        - makes an image suitable for development, e.g. allowing passwordless root logins
#   - empty-root-password
#   - allow-empty-password
#   - post-install-logging
# - dev-pkgs            - development packages (headers, etc.) for all installed packages in the rootfs
# - dbg-pkgs            - debug symbol packages for all installed packages in the rootfs
# - doc-pkgs            - documentation packages for all installed packages in the rootfs
# - ptest-pkgs          - ptest packages for all ptest-enabled recipes
# - read-only-rootfs    - tweaks an image to support read-only rootfs
# - splash              - bootup splash screen
#
IMAGE_FEATURES_remove += " x11  "
EXTRA_IMAGE_FEATURES_remove += " x11  "
EXTRA_IMAGE_FEATURES += " read-only-rootfs package-management "

CORE_IMAGE_EXTRA_INSTALL += " kernel-modules"

HOSTTOOLS_append = " svn unzip "

#QT_PROVIDER = "qt5"
#meta-arago/meta-arago-distro/conf/distro/include/branding-amsdk.inc:QT_PROVIDER := "${@bb.utils.contains('SOC_FAMILY','omap-a15:dra7xx','qt5','qt4e',d)}"
```
